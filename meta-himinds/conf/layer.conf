## meta-himinds/conf/layer.conf
```bitbake
# We have a conf and classes directory, add to BBPATH
BBPATH .= ":${LAYERDIR}"

# We have recipes-* directories, add to BBFILES
BBFILES += "${LAYERDIR}/recipes-*/*/*.bb \
            ${LAYERDIR}/recipes-*/*/*.bbappend"

BBFILE_COLLECTIONS += "meta-himinds"
BBFILE_PATTERN_meta-himinds = "^${LAYERDIR}/"
BBFILE_PRIORITY_meta-himinds = "6"
```
